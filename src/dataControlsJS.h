const char JS_CONTROLS[] PROGMEM = R"=====(
const UI_INITIAL_GUI=200;const UI_RELOAD=201;const UPDATE_OFFSET=100;const UI_EXTEND_GUI=210;const UI_TITEL=0;const UI_PAD=1;const UPDATE_PAD=101;const UI_CPAD=2;const UPDATE_CPAD=102;const UI_BUTTON=3;const UPDATE_BUTTON=103;const UI_LABEL=4;const UPDATE_LABEL=104;const UI_SWITCHER=5;const UPDATE_SWITCHER=105;const UI_SLIDER=6;const UPDATE_SLIDER=106;const UI_NUMBER=7;const UPDATE_NUMBER=107;const UI_TEXT_INPUT=8;const UPDATE_TEXT_INPUT=108;const UI_GRAPH=9;const ADD_GRAPH_POINT=10;const CLEAR_GRAPH=109;const UI_TAB=11;const UPDATE_TAB=111;const UI_SELECT=12;const UPDATE_SELECT=112;const UI_OPTION=13;const UPDATE_OPTION=113;const UI_MIN=14;const UPDATE_MIN=114;const UI_MAX=15;const UPDATE_MAX=115;const UI_STEP=16;const UPDATE_STEP=116;const UI_GAUGE=17;const UPDATE_GAUGE=117;const UI_ACCEL=18;const UPDATE_ACCEL=118;const UI_SEPARATOR=19;const UPDATE_SEPARATOR=119;const UI_TIME=20;const UPDATE_TIME=120;const UI_FILEDISPLAY=21;const UPDATE_FILEDISPLAY=121;const UI_COLOR_PICKR=22;const UPDATE_COLOR_PICKR=122;const UI_DETAILS=23;const UPDATE_DETAILS=123;const UI_FRAGMENT=98;const UP=0;const DOWN=1;const LEFT=2;const RIGHT=3;const CENTER=4;const C_TURQUOISE=0;const C_EMERALD=1;const C_PETERRIVER=2;const C_WETASPHALT=3;const C_SUNFLOWER=4;const C_CARROT=5;const C_ALIZARIN=6;const C_DARK=7;const C_NONE=255;var controlAssemblyArray=new Object();var FragmentAssemblyTimer=new Array();var graphData=new Array();var hasAccel=false;var sliderContinuous=false;function colorClass(colorId){colorId=Number(colorId);switch(colorId){case C_TURQUOISE:return"turquoise";case C_EMERALD:return"emerald";case C_PETERRIVER:return"peterriver";case C_WETASPHALT:return"wetasphalt";case C_SUNFLOWER:return"sunflower";case C_CARROT:return"carrot";case C_ALIZARIN:return"alizarin";case C_DARK:case C_NONE:return"dark";default:return"";}}
function updateTabsBorderColor(tabLink){var tabBorderColors={turquoise:"#1abc9c",emerald:"#2ecc71",peterriver:"#3498db",wetasphalt:"#34495e",sunflower:"#f1c40f",carrot:"#e67e22",alizarin:"#e74c3c",dark:"#444857"};var tabClass=tabLink?tabLink.className:"";$("#tabsnav").css("border-bottom-color",tabBorderColors[tabClass]||"#666");}
var websock;var websockConnected=false;var WebSocketTimer=null;function requestOrientationPermission(){}
function saveGraphData(){localStorage.setItem("espuigraphs",JSON.stringify(graphData));}
function restoreGraphData(id){var savedData=localStorage.getItem("espuigraphs",graphData);if(savedData!=null){savedData=JSON.parse(savedData);let idData=savedData[id];return Array.isArray(idData)?idData:[];}
return[];}
function restart(){disposeColorPickrs();$(document).add("*").off();$("#row").html("");conStatusError();start();}
function conStatusError(){FragmentAssemblyTimer.forEach(element=>{clearInterval(element);});FragmentAssemblyTimer=new Array();controlAssemblyArray=new Array();if(true===websockConnected){websockConnected=false;websock.close();$("#conStatus").removeClass("color-green");$("#conStatus").addClass("color-red");$("#conStatus").html("Error / No Connection &#8635;");$("#conStatus").off();$("#conStatus").on({click:restart,});}}
function handleVisibilityChange(){if(!websockConnected&&!document.hidden){restart();}}
function start(){let location=window.location.hostname;let port=window.location.port;document.addEventListener("visibilitychange",handleVisibilityChange,false);if(port!=""||port!=80||port!=443){websock=new WebSocket("ws://"+location+":"+port+"/ws");}else{websock=new WebSocket("ws://"+location+"/ws");}
if(null===WebSocketTimer){WebSocketTimer=setInterval(function(){if(websock.readyState===3){restart();}},5000);}
websock.onopen=function(evt){console.log("websock open");$("#conStatus").addClass("color-green");$("#conStatus").text("Connected");websockConnected=true;FragmentAssemblyTimer.forEach(element=>{clearInterval(element);});FragmentAssemblyTimer=new Array();controlAssemblyArray=new Array();};websock.onclose=function(evt){console.log("websock close");conStatusError();FragmentAssemblyTimer.forEach(element=>{clearInterval(element);});FragmentAssemblyTimer=new Array();controlAssemblyArray=new Array();};websock.onerror=function(evt){console.log("websock Error");restart();FragmentAssemblyTimer.forEach(element=>{clearInterval(element);});FragmentAssemblyTimer=new Array();controlAssemblyArray=new Array();};var handleEvent=function(evt){try{var data=JSON.parse(evt.data);}
catch(Event){console.error(Event);websock.send("uiok:"+0);return;}
var e=document.body;var center="";switch(data.type){case UI_INITIAL_GUI:disposeColorPickrs();$("#row").html("");$("#tabsnav").html("");$("#tabscontent").html("");if(data.sliderContinuous){sliderContinuous=data.sliderContinuous;}
data.controls.forEach(element=>{var fauxEvent={data:JSON.stringify(element),};handleEvent(fauxEvent);});if(data.totalcontrols>(data.controls.length-1)){websock.send("uiok:"+(data.controls.length-1));}else{console.log("sending uicc");websock.send("uicc:1");}
break;case UI_EXTEND_GUI:data.controls.forEach(element=>{var fauxEvent={data:JSON.stringify(element),};handleEvent(fauxEvent);});if(data.totalcontrols>data.startindex+(data.controls.length-1)){websock.send("uiok:"+(data.startindex+(data.controls.length-1)));}else{console.log("sending uicc");websock.send("uicc:1");}
break;case UI_RELOAD:window.location.reload();break;case UI_TITEL:document.title=data.label;$("#mainHeader").html(data.label);break;case UI_LABEL:case UI_NUMBER:case UI_TEXT_INPUT:case UI_SELECT:case UI_GAUGE:case UI_SEPARATOR:case UI_DETAILS:if(data.visible)addToHTML(data);break;case UI_COLOR_PICKR:if(data.visible){addToHTML(data);initColorPickr(data);}
break;case UI_BUTTON:if(data.visible){addToHTML(data);$("#btn"+data.id).on({touchstart:function(e){e.preventDefault();if($(this).prop("disabled"))return;$(this).addClass("pressed");buttonclick(data.id,true);},touchend:function(e){e.preventDefault();if($(this).prop("disabled"))return;$(this).removeClass("pressed");buttonclick(data.id,false);},});}
break;case UI_SWITCHER:if(data.visible){addToHTML(data);switcher(data.id,data.value);}
break;case UI_CPAD:case UI_PAD:if(data.visible){addToHTML(data);$("#pf"+data.id).on({touchstart:function(e){e.preventDefault();padclick(UP,data.id,true);},touchend:function(e){e.preventDefault();padclick(UP,data.id,false);},});$("#pl"+data.id).on({touchstart:function(e){e.preventDefault();padclick(LEFT,data.id,true);},touchend:function(e){e.preventDefault();padclick(LEFT,data.id,false);},});$("#pr"+data.id).on({touchstart:function(e){e.preventDefault();padclick(RIGHT,data.id,true);},touchend:function(e){e.preventDefault();padclick(RIGHT,data.id,false);},});$("#pb"+data.id).on({touchstart:function(e){e.preventDefault();padclick(DOWN,data.id,true);},touchend:function(e){e.preventDefault();padclick(DOWN,data.id,false);},});$("#pc"+data.id).on({touchstart:function(e){e.preventDefault();padclick(CENTER,data.id,true);},touchend:function(e){e.preventDefault();padclick(CENTER,data.id,false);},});}
break;case UI_SLIDER:if(data.visible){addToHTML(data);rangeSlider(!sliderContinuous);}
break;case UI_TAB:if(data.visible){var tabName=data.label;if(typeof tabName!=="string"||tabName.length===0){tabName="tab"+($("#tabsnav li").length+1);}
var tabColorClass=Number(data.color)===C_NONE?"":colorClass(data.color);var tabColorAttribute=tabColorClass?" class='"+tabColorClass+"'":"";$("#tabsnav").append("<li><a"+tabColorAttribute+" onmouseup='tabclick("+data.id+");updateTabsBorderColor(this)' href='#"+tabName+"'>"+data.value+"</a></li>");$("#tabscontent").append("<div id='"+tabName+"' data-control-id='"+data.id+"'></div>");tabs=$(".tabscontent").tabbedContent({loop:true}).data("api");updateTabsBorderColor($("#tabsnav li.active a")[0]);$("a").filter(function(){return $(this).attr("href")==="#click-to-switch";}).on("click",function(e){var tab=prompt("Tab to switch to (number or id)?");if(!tabs.switchTab(tab)){alert("That tab does not exist :\\");}
e.preventDefault();});}
break;case UI_OPTION:if(data.parentControl){var parent=$("#select"+data.parentControl);if(data.value=="-3")
break;if(data.value=="-2")
parent.append("<option id='option"+
data.id+
"' value='"+
data.value+
"' "+"hidden>"+
data.label+
"</option>");else
parent.append("<option id='option"+
data.id+
"' value='"+
data.value+
"' "+
data.selected+
">"+
data.label+
"</option>");}
if(data.hasOwnProperty('secondParent')){var parentB=$("#select"+data.secondParent);if(data.value=="-2")
parentB.append("<option id='optionB"+
data.id+
"' value='"+
data.value+
"' "+"hidden>"+
data.label+
"</option>");else
parentB.append("<option id='optionB"+
data.id+
"' value='"+
data.value+
"' "+
data.selected+
">"+
data.label+
"</option>");}
if(data.hasOwnProperty('thirdParent')){var parentC=$("#select"+data.thirdParent);if(data.value=="-2")
parentC.append("<option id='optionC"+
data.id+
"' value='"+
data.value+
"' "+"hidden>"+
data.label+
"</option>");else
parentC.append("<option id='optionC"+
data.id+
"' value='"+
data.value+
"' "+
data.selected+
">"+
data.label+
"</option>");}
break;case UI_MIN:if(data.parentControl){if($('#sl'+data.parentControl).length){$('#sl'+data.parentControl).attr("min",data.value);}else if($('#num'+data.parentControl).length){$('#num'+data.parentControl).attr("min",data.value);}}
break;case UI_MAX:if(data.parentControl){if($('#sl'+data.parentControl).length){$('#sl'+data.parentControl).attr("max",data.value);}else if($('#text'+data.parentControl).length){$('#text'+data.parentControl).attr("maxlength",data.value);}else if($('#num'+data.parentControl).length){$('#num'+data.parentControl).attr("max",data.value);}}
break;case UI_STEP:if(data.parentControl){if($('#sl'+data.parentControl).length){$('#sl'+data.parentControl).attr("step",data.value);}else if($('#num'+data.parentControl).length){$('#num'+data.parentControl).attr("step",data.value);}}
break;case UI_GRAPH:if(data.visible){addToHTML(data);graphData[data.id]=restoreGraphData(data.id);renderGraphSvg(graphData[data.id],"graph"+data.id);}
break;case ADD_GRAPH_POINT:var ts=new Date().getTime();graphData[data.id].push({x:ts,y:data.value});saveGraphData();renderGraphSvg(graphData[data.id],"graph"+data.id);break;case CLEAR_GRAPH:graphData[data.id]=[];saveGraphData();renderGraphSvg(graphData[data.id],"graph"+data.id);break;case UI_ACCEL:if(hasAccel)break;hasAccel=true;if(data.visible){addToHTML(data);requestOrientationPermission();}
break;case UI_FILEDISPLAY:if(data.visible)
{addToHTML(data);FileDisplayUploadFile(data);}
break;case UPDATE_LABEL:if(data.value.startsWith("Z2S_GUI_CMD_")){if(typeof window.onGatewayCommand==="function"){window.onGatewayCommand(data.value,data.id);}
break;}
$("#l"+data.id).html(data.value);if(data.hasOwnProperty('elementStyle')){$("#l"+data.id).attr("style",data.elementStyle);}
break;case UPDATE_DETAILS:if(data.value.startsWith("Z2S_GUI_CMD_")){if(typeof window.onGatewayCommand==="function"){window.onGatewayCommand(data.value,data.id);}
break;}
$("#id"+data.id).prop("open",!!data.expanded);$("#l"+data.id).html(data.value);if(data.hasOwnProperty('elementStyle')){$("#l"+data.id).attr("style",data.elementStyle);}
break;case UPDATE_SWITCHER:switcher(data.id,data.value=="0"?0:1);if(data.hasOwnProperty('elementStyle')){var wrapperCssObj={};var innerStyle=data.elementStyle.replace(/(?:^|\s)(width|min-width|max-width|margin(?:-[a-z]+)?|float)\s*:\s*([^;]+);?/gi,function(match,prop,val){wrapperCssObj[prop]=val;return"";});if(Object.keys(wrapperCssObj).length>0){$("#switcher-wrapper-"+data.id).css(wrapperCssObj);}
$("#sl"+data.id).attr("style",innerStyle);}
if(data.hasOwnProperty('label')&&$("#input-label-"+data.id).length){var safeLabel=data.label.replace(/<[^>]*>?/gm,'').replace(/'/g,"&#39;").replace(/"/g,"&quot;");$("#input-label-"+data.id).html(data.label);$("#input-label-"+data.id).attr("title",safeLabel);}
break;case UPDATE_SLIDER:$("#sl"+data.id).attr("value",data.value);if(typeof slider_move==="function"){slider_move($("#sl"+data.id).parent().parent(),data.value,"100",false);}
if(data.hasOwnProperty('elementStyle')){var wrapperCssObj={};var innerStyle=data.elementStyle.replace(/(?:^|\s)(width|min-width|max-width|margin(?:-[a-z]+)?|float)\s*:\s*([^;]+);?/gi,function(match,prop,val){wrapperCssObj[prop]=val;return"";});if(Object.keys(wrapperCssObj).length>0){$("#slider-wrapper-"+data.id).css(wrapperCssObj);}
$("#sl"+data.id).attr("style",innerStyle);}
if(data.hasOwnProperty('label')&&$("#input-label-"+data.id).length){var safeLabel=data.label.replace(/<[^>]*>?/gm,'').replace(/'/g,"&#39;").replace(/"/g,"&quot;");$("#input-label-"+data.id).html(data.label);$("#input-label-"+data.id).attr("title",safeLabel);}
break;case UPDATE_NUMBER:$("#num"+data.id).val(data.value);if(data.hasOwnProperty('elementStyle')){var wrapperCssObj={};var innerStyle=data.elementStyle.replace(/(?:^|\s)(width|min-width|max-width|margin(?:-[a-z]+)?|float)\s*:\s*([^;]+);?/gi,function(match,prop,val){wrapperCssObj[prop]=val;return"";});if(Object.keys(wrapperCssObj).length>0){$("#number-wrapper-"+data.id).css(wrapperCssObj);}
$("#num"+data.id).attr("style","width: 100%; max-width: 100%; box-sizing: border-box; color:black; "+innerStyle);}
if(data.hasOwnProperty('label')){var safeLabel=data.label.replace(/<[^>]*>?/gm,'').replace(/'/g,"&#39;").replace(/"/g,"&quot;");if($("#input-label-"+data.id).length){$("#input-label-"+data.id).html(data.label);$("#input-label-"+data.id).attr("title",safeLabel);}else{$("#num"+data.id).attr("placeholder",safeLabel);}}
break;case UPDATE_COLOR_PICKR:syncColorPickr(data.id,data.value);if(data.hasOwnProperty('elementStyle')){$("#text"+data.id).parent().attr("style",data.elementStyle);}
break;case UPDATE_TEXT_INPUT:$("#text"+data.id).val(data.value);if(data.hasOwnProperty('elementStyle')){var wrapperCssObj={};var innerStyle=data.elementStyle.replace(/(?:^|\s)(width|min-width|max-width|margin(?:-[a-z]+)?|float)\s*:\s*([^;]+);?/gi,function(match,prop,val){wrapperCssObj[prop]=val;return"";});if(Object.keys(wrapperCssObj).length>0){$("#text-wrapper-"+data.id).css(wrapperCssObj);}
$("#text"+data.id).attr("style","width: 100%; max-width: 100%; box-sizing: border-box; color:black; "+innerStyle);}
if(data.hasOwnProperty('label')){var safeLabel=data.label.replace(/<[^>]*>?/gm,'').replace(/'/g,"&#39;").replace(/"/g,"&quot;");if($("#input-label-"+data.id).length){$("#input-label-"+data.id).html(data.label);$("#input-label-"+data.id).attr("title",safeLabel);}else{$("#text"+data.id).attr("placeholder",safeLabel);}}
if(data.hasOwnProperty('textarea')&&data.textarea){if(data.hasOwnProperty('rows'))$("#text"+data.id).attr("rows",data.rows);if(data.hasOwnProperty('cols'))$("#text"+data.id).attr("cols",data.cols);}else if(data.hasOwnProperty('inputType')){$("#text"+data.id).attr("type",data.inputType);}
break;case UPDATE_SELECT:$("#select"+data.id).val(data.value);if(data.hasOwnProperty('elementStyle')){var wrapperCssObj={};var innerStyle=data.elementStyle.replace(/(?:^|\s)(width|min-width|max-width|margin(?:-[a-z]+)?|float)\s*:\s*([^;]+);?/gi,function(match,prop,val){wrapperCssObj[prop]=val;return"";});if(Object.keys(wrapperCssObj).length>0){$("#select-wrapper-"+data.id).css(wrapperCssObj);}
$("#select"+data.id).attr("style","width: 100%; max-width: 100%; box-sizing: border-box; color:black; "+innerStyle);}
if(data.hasOwnProperty('label')&&$("#input-label-"+data.id).length){var safeLabel=data.label.replace(/<[^>]*>?/gm,'').replace(/'/g,"&#39;").replace(/"/g,"&quot;");$("#input-label-"+data.id).html(data.label);$("#input-label-"+data.id).attr("title",safeLabel);}
break;case UPDATE_OPTION:var parent=$("#select"+data.parentControl);var option=$("#option"+data.id);if(data.hasOwnProperty('secondParent')){var parentB=$("#select"+data.secondParent);var optionB=$("#optionB"+data.id);if(optionB.length>0){if(data.value=="-2")
optionB.remove();else{optionB.val(data.value);optionB.text(data.label);}}
else{if(Number(data.value)>-2)
parentB.append("<option id='optionB"+
data.id+
"' value='"+
data.value+
"' "+">"+
data.label+
"</option>");}}
if(data.hasOwnProperty('thirdParent')){var parentC=$("#select"+data.thirdParent);var optionC=$("#optionC"+data.id);if(optionC.length>0){if(data.value=="-2")
optionC.remove();else{optionC.val(data.value);optionC.text(data.label);}}
else{if(Number(data.value)>-2)
parentC.append("<option id='optionC"+
data.id+
"' value='"+
data.value+
"' "+">"+
data.label+
"</option>");}}
if(option.length>0){if(data.value=="-2")
option.remove();else{option.val(data.value);option.text(data.label);}}
else{if(Number(data.value)>-2)
parent.append("<option id='option"+
data.id+
"' value='"+
data.value+
"' "+">"+
data.label+
"</option>");}
break;case UPDATE_BUTTON:$("#btn"+data.id).html(data.value);if(data.hasOwnProperty('elementStyle')){var customStyle=data.elementStyle;if(!customStyle.includes("vertical-align"))customStyle+="vertical-align: bottom; ";$("#btn"+data.id).attr("style",customStyle);}
break;case UPDATE_PAD:case UPDATE_CPAD:break;case UPDATE_GAUGE:$("#gauge"+data.id).val(data.value);if(data.hasOwnProperty('elementStyle')){$("#gauge"+data.id).attr("style",data.elementStyle);}
break;case UPDATE_ACCEL:break;case UPDATE_TIME:var rv=new Date().toISOString();websock.send("time:"+rv+":"+data.id);break;case UPDATE_FILEDISPLAY:FileDisplayUploadFile(data);break;case UI_FRAGMENT:let FragmentLen=data.length;let FragementOffset=data.offset;let NextFragmentOffset=FragementOffset+FragmentLen;let Total=data.total;let Arrived=(FragmentLen+FragementOffset);let FragmentFinal=Total===Arrived;if(!data.hasOwnProperty('control'))
{console.error("UI_FRAGMENT:Missing control record, skipping control");break;}
let control=data.control;StopFragmentAssemblyTimer(data.control.id);if(0===FragementOffset)
{controlAssemblyArray[control.id]=data;controlAssemblyArray[control.id].offset=NextFragmentOffset;StartFragmentAssemblyTimer(control.id);let TotalRequest=JSON.stringify({'id':control.id,'offset':NextFragmentOffset});websock.send("uifragmentok:"+0+": "+TotalRequest+":");break;}
if("undefined"===typeof controlAssemblyArray[control.id])
{console.error("Missing first fragment for control: "+control.id);StartFragmentAssemblyTimer(control.id);let TotalRequest=JSON.stringify({'id':control.id,'offset':0});websock.send("uifragmentok:"+0+": "+TotalRequest+":");break;}
if(FragementOffset!==controlAssemblyArray[control.id].offset)
{if(FragementOffset>controlAssemblyArray[control.id].offset){console.warn("Out-of-order fragment. Expected: "+controlAssemblyArray[control.id].offset+" Got: "+FragementOffset);}
StartFragmentAssemblyTimer(control.id);let TotalRequest=JSON.stringify({'id':control.id,'offset':controlAssemblyArray[control.id].offset});websock.send("uifragmentok:"+0+": "+TotalRequest+":");break;}
controlAssemblyArray[control.id].control.value+=control.value;controlAssemblyArray[control.id].offset=NextFragmentOffset;if(true===FragmentFinal)
{var fauxEvent={data:JSON.stringify(controlAssemblyArray[control.id].control),};handleEvent(fauxEvent);controlAssemblyArray[control.id]=null;}
else
{StartFragmentAssemblyTimer(control.id);let TotalRequest=JSON.stringify({'id':control.id,'offset':NextFragmentOffset});websock.send("uifragmentok:"+0+": "+TotalRequest+":");}
break;default:console.error("Unknown type or event");console.error(data.type);break;}
if(data.type>=UI_TITEL&&data.type<UPDATE_OFFSET){processEnabled(data);}
if(data.type>=UPDATE_OFFSET&&data.type<UI_INITIAL_GUI){var element=$("#id"+data.id);if(data.hasOwnProperty('panelStyle')){$("#id"+data.id).attr("style",data.panelStyle);}
if(data.hasOwnProperty('visible')){if(data['visible'])
$("#id"+data.id).show();else
$("#id"+data.id).hide();}
if(data.type==UPDATE_SLIDER){element.removeClass("slider-turquoise slider-emerald slider-peterriver slider-wetasphalt slider-sunflower slider-carrot slider-alizarin");element.addClass("slider-"+colorClass(data.color));}else{element.removeClass("turquoise emerald peterriver wetasphalt sunflower carrot alizarin");element.addClass(colorClass(data.color));}
processEnabled(data);}
$(".range-slider__range").each(function(){$(this)[0].value=$(this).attr("value");$(this).next().html($(this).attr("value"));});};websock.onmessage=handleEvent;}
async function FileDisplayUploadFile(data)
{let text=await downloadFile(data.value);let ItemToUpdateId="fd"+data.id;$("#"+ItemToUpdateId).val(text);$("#"+ItemToUpdateId).css("textAlign","left");$("#"+ItemToUpdateId).css("white-space","nowrap");$("#"+ItemToUpdateId).css("overflow","scroll");$("#"+ItemToUpdateId).css("overflow-y","scroll");$("#"+ItemToUpdateId).css("overflow-x","scroll");$("#"+ItemToUpdateId).scrollTop($("#"+ItemToUpdateId).val().length);}
async function downloadFile(filename)
{let response=await fetch(filename);if(response.status!=200){throw new Error("File Read Server Error: '"+response.status+"'");}
let text_data=await response.text();return text_data;}
function StartFragmentAssemblyTimer(Id)
{StopFragmentAssemblyTimer(Id);FragmentAssemblyTimer[Id]=setInterval(function(_Id)
{if("undefined"!==typeof controlAssemblyArray[_Id])
{if(null!==controlAssemblyArray[_Id])
{let TotalRequest=JSON.stringify({'id':controlAssemblyArray[_Id].control.id,'offset':controlAssemblyArray[_Id].offset});websock.send("uifragmentok:"+0+": "+TotalRequest+":");}}},1000,Id);}
function StopFragmentAssemblyTimer(Id)
{if("undefined"!==typeof FragmentAssemblyTimer[Id])
{if(FragmentAssemblyTimer[Id])
{clearInterval(FragmentAssemblyTimer[Id]);}}}
function sliderchange(number){var val=$("#sl"+number).val();websock.send("slvalue:"+val+":"+number);$(".range-slider__range").each(function(){$(this).attr("value",$(this)[0].value);});}
function numberchange(number){var val=$("#num"+number).val();websock.send("nvalue:"+val+":"+number);}
function textchange(number){var val=$("#text"+number).val();websock.send("tvalue:"+val+":"+number);}
function tabclick(number){var val=$("[data-control-id='"+number+"']").val();websock.send("tabvalue:"+val+":"+number);}
function selectchange(number){var val=$("#select"+number).val();websock.send("svalue:"+val+":"+number);}
function buttonclick(number,isdown){if($("#btn"+number).prop("disabled")){return;}
$("#btn"+number).focus();if(isdown)websock.send("bdown:"+number);else websock.send("bup:"+number);}
function padclick(type,number,isdown){if($("#id"+number+" nav").hasClass("disabled")){return;}
switch(type){case CENTER:if(isdown)websock.send("pcdown:"+number);else websock.send("pcup:"+number);break;case UP:if(isdown)websock.send("pfdown:"+number);else websock.send("pfup:"+number);break;case DOWN:if(isdown)websock.send("pbdown:"+number);else websock.send("pbup:"+number);break;case LEFT:if(isdown)websock.send("pldown:"+number);else websock.send("plup:"+number);break;case RIGHT:if(isdown)websock.send("prdown:"+number);else websock.send("prup:"+number);break;}}
function switcher(number,state){if(state==null){if(!$("#sl"+number).hasClass("checked")){websock.send("sactive:"+number);$("#sl"+number).addClass("checked");}else{websock.send("sinactive:"+number);$("#sl"+number).removeClass("checked");}}else if(state==1){$("#sl"+number).addClass("checked");$("#sl"+number).prop("checked",true);}else if(state==0){$("#sl"+number).removeClass("checked");$("#sl"+number).prop("checked",false);}}
var rangeSlider=function(isDiscrete){var range=$(".range-slider__range");var slidercb=function(){sliderchange($(this).attr("id").replace(/^\D+/g,""));};range.on({input:function(){$(this).next().html(this.value)}});range.each(function(){$(this).next().html(this.value);if($(this).attr("callbackSet")!="true"){if(!isDiscrete){$(this).on({input:slidercb});}else{$(this).on({change:slidercb});}
$(this).attr("callbackSet","true");}});};var colorPickrInstances=Object.create(null);function disposeColorPickrs(){Object.keys(colorPickrInstances).forEach(function(id){var state=colorPickrInstances[id];state.ready=false;state.silent=true;state.input.removeEventListener('input',state.onInput);state.picker.destroyAndRemove();});colorPickrInstances=Object.create(null);}
function initColorPickr(data){var input=document.getElementById('text'+data.id);var button=document.getElementById('colorbtn'+data.id);var state={input:input,ready:false,silent:false,open:false,snapshot:'#000000',picker:null};colorPickrInstances[data.id]=state;syncColorPickr(data.id,data.value);state.onInput=function(){syncColorPickr(data.id);};input.addEventListener('input',state.onInput);state.picker=Pickr.create({el:button,theme:'monolith',useAsButton:true,default:input.dataset.lastColor,lockOpacity:true,defaultRepresentation:'HEX',comparison:true,swatches:['#000000','#FFFFFF','#FF0000','#00FF00','#0000FF','#FFFF00','#00FFFF','#FF00FF'],components:{opacity:false,hue:true,preview:true,interaction:{input:true,save:true,cancel:true,clear:false}}});state.picker.on('init',function(){if(colorPickrInstances[data.id]!==state)return;state.ready=true;syncColorPickr(data.id,input.dataset.lastColor);if(input.disabled)state.picker.disable();}).on('show',function(){if(!state.ready||input.disabled){state.picker.hide();return;}
Object.keys(colorPickrInstances).forEach(function(id){var other=colorPickrInstances[id];if(other!==state&&other.open)other.picker.hide();});state.open=true;state.snapshot=input.dataset.lastColor;syncColorPickr(data.id,state.snapshot);}).on('change',function(color){if(!state.ready||state.silent||!state.open||input.disabled||!color)return;input.value=color.toHEXA().toString().slice(0,7).toUpperCase();syncColorPickr(data.id);}).on('save',function(color){if(!state.ready||state.silent||!state.open||input.disabled||!color)return;input.value=color.toHEXA().toString().slice(0,7).toUpperCase();commitColorPickr(data.id,true);state.picker.hide();}).on('cancel',function(){if(!state.ready||state.silent)return;syncColorPickr(data.id,state.snapshot);state.picker.hide();}).on('hide',function(){state.open=false;if(!state.ready||state.silent)return;syncColorPickr(data.id,state.snapshot);});}
function syncColorPickr(id,value){var state=colorPickrInstances[id];if(!state)return;var input=state.input;if(value!==undefined){input.value=/^#[0-9a-f]{6}$/i.test(value)?value.toUpperCase():(input.dataset.lastColor||'#000000');input.dataset.lastColor=input.value;state.snapshot=input.value;if(state.ready){state.silent=true;try{state.picker.setColor(input.value,true);state.picker.applyColor(true);}finally{state.silent=false;}}}
var valid=/^#[0-9a-f]{6}$/i.test(input.value);input.setCustomValidity(valid?'':'Enter a color as #RRGGBB');if(valid){document.getElementById('colorbtn'+id).style.backgroundColor=input.value;}}
function commitColorPickr(id,confirmed){var state=colorPickrInstances[id];if(!state||!state.ready||state.silent||state.input.disabled)return;if(state.open&&!confirmed)return;var input=state.input;if(!/^#[0-9a-f]{6}$/i.test(input.value)){syncColorPickr(id,input.dataset.lastColor);return;}
var value=input.value.toUpperCase();var changed=value!==input.dataset.lastColor;syncColorPickr(id,value);if(changed)textchange(id);}
var addToHTML=function(data){panelStyle=data.hasOwnProperty('panelStyle')?" style='"+data.panelStyle+"' ":"";panelwide=data.hasOwnProperty('wide')?"wide":"";var tabPanel=$("[data-control-id='"+data.parentControl+"']");if(!data.hasOwnProperty('parentControl')||tabPanel.length>0){var parent=data.hasOwnProperty('parentControl')?tabPanel:$("#row");var html="";switch(data.type){case UI_LABEL:case UI_BUTTON:case UI_SWITCHER:case UI_CPAD:case UI_PAD:case UI_SLIDER:case UI_NUMBER:case UI_TEXT_INPUT:case UI_COLOR_PICKR:case UI_SELECT:case UI_GRAPH:case UI_GAUGE:case UI_ACCEL:case UI_FILEDISPLAY:html="<div id='id"+data.id+"' "+panelStyle+" class='two columns "+panelwide+" card tcenter "+
colorClass(data.color)+"'><h5>"+data.label+"</h5><hr/>"+
elementHTML(data)+
"</div>";break;case UI_DETAILS:html="<details id='id"+data.id+"' "+(data.expanded?"open ":"")+panelStyle+" class='two columns "+panelwide+" card tcenter "+
colorClass(data.color)+"'>"+
"<summary class='details-summary'><h5>"+data.label+"</h5></summary><hr/>"+
elementHTML(data)+
"</details>";break;case UI_SEPARATOR:html="<div id='id"+data.id+"' "+panelStyle+" class='sectionbreak columns'>"+
"<h5>"+data.label+"</h5><hr/></div>";break;case UI_TIME:break;}
parent.append(html);}else{var parent=$("#id"+data.parentControl);parent.append(elementHTML(data));}}
var elementHTML=function(data){var id=data.id
var elementStyle=data.hasOwnProperty('elementStyle')?" style='"+data.elementStyle+"' ":"";var inputType=data.hasOwnProperty('inputType')?" type='"+data.inputType+"' ":"";switch(data.type){case UI_LABEL:case UI_DETAILS:var customStyle=data.hasOwnProperty('elementStyle')?data.elementStyle:"";return"<span id='l"+id+"' style='"+customStyle+"' class='label label-wrap'>"+data.value+"</span>";case UI_FILEDISPLAY:return"<textarea id='fd"+id+"' rows='4' "+elementStyle+
" class='label label-wrap'>"+"</textarea>";case UI_BUTTON:var customStyle=data.hasOwnProperty('elementStyle')?data.elementStyle:"";if(!customStyle.includes("vertical-align"))customStyle+="vertical-align: bottom; ";return"<button id='btn"+id+"' style='"+customStyle+"' "+
"onmousedown='buttonclick("+id+", true)' onmouseup='buttonclick("+id+", false)'>"+
data.value+"</button>";case UI_SWITCHER:var customStyle=data.hasOwnProperty('elementStyle')?data.elementStyle:"";var isNested=data.hasOwnProperty('parentControl')&&$("#tab"+data.parentControl).length===0;var safeLabel=data.label?data.label.replace(/<[^>]*>?/gm,'').replace(/'/g,"&#39;").replace(/"/g,"&quot;"):"";var onClickScript="this.style.whiteSpace = this.style.whiteSpace === 'nowrap' ? 'normal' : 'nowrap';";var nestedLabel=isNested?"<div id='input-label-"+id+"' title='"+safeLabel+"' onclick=\""+onClickScript+"\" style='font-size:14px; text-align:center; margin-top:6px; white-space: nowrap; overflow: hidden; text-overflow: ellipsis; max-width: 100%; width: 100%; cursor: pointer;'>"+data.label+"</div>":"";var wrapperExtractedStyles="";var innerStyle=customStyle.replace(/(?:^|\s)(width|min-width|max-width|margin(?:-[a-z]+)?|float)\s*:\s*([^;]+);?/gi,function(match,prop,val){wrapperExtractedStyles+=prop+": "+val+"; ";return"";});if(!wrapperExtractedStyles.includes("margin")){wrapperExtractedStyles+="margin: 8px; ";}
var controlHTML="<label id='sl"+id+"' style='"+innerStyle+"'"+
" class='switch "+(data.value=="1"?"checked":"")+
(data.hasOwnProperty('vertical')?" vert-switcher ":"")+
"'>"+
"<div class='in'>"+
"<input type='checkbox' id='s"+id+"' onClick='switcher("+id+",null)' "+
(data.value=="1"?"checked":"")+"/></div></label>";var wrapperStyle="display: inline-flex; flex-direction: column; align-items: center; vertical-align: bottom; max-width: 100%; "+wrapperExtractedStyles;return"<div id='switcher-wrapper-"+id+"' style='"+wrapperStyle+"'>"+controlHTML+nestedLabel+"</div>";case UI_CPAD:case UI_PAD:return"<nav class='control'><ul>"+
"<li><a onmousedown='padclick(UP, "+id+", true)' "+
"onmouseup='padclick(UP, "+id+", false)' id='pf"+id+"'>&#9650;</a></li>"+
"<li><a onmousedown='padclick(RIGHT, "+id+", true)' "+
"onmouseup='padclick(RIGHT, "+id+", false)' id='pr"+id+"'>&#9650;</a></li>"+
"<li><a onmousedown='padclick(LEFT, "+id+", true)' "+
"onmouseup='padclick(LEFT, "+id+", false)' id='pl"+id+"'>&#9650;</a></li>"+
"<li><a onmousedown='padclick(DOWN, "+id+", true)' "+
"onmouseup='padclick(DOWN, "+id+", false)' id='pb"+id+"'>&#9650;</a></li>"+
"</ul>"+
(data.type==UI_CPAD?"<a class='confirm' onmousedown='padclick(CENTER,"+id+", true)' "+
"onmouseup='padclick(CENTER, "+id+", false)' id='pc"+id+"'>OK</a>":"")+
"</nav>";case UI_SLIDER:var customStyle=data.hasOwnProperty('elementStyle')?data.elementStyle:"";var isNested=data.hasOwnProperty('parentControl')&&$("#tab"+data.parentControl).length===0;var safeLabel=data.label?data.label.replace(/<[^>]*>?/gm,'').replace(/'/g,"&#39;").replace(/"/g,"&quot;"):"";var onClickScript="this.style.whiteSpace = this.style.whiteSpace === 'nowrap' ? 'normal' : 'nowrap';";var nestedLabel=isNested?"<div id='input-label-"+id+"' title='"+safeLabel+"' onclick=\""+onClickScript+"\" style='font-size:14px; text-align: left; margin-bottom:2px; white-space: nowrap; overflow: hidden; text-overflow: ellipsis; max-width: 100%; width: 100%; cursor: pointer;'>"+data.label+"</div>":"";var wrapperExtractedStyles="";var innerStyle=customStyle.replace(/(?:^|\s)(width|min-width|max-width|margin(?:-[a-z]+)?|float)\s*:\s*([^;]+);?/gi,function(match,prop,val){wrapperExtractedStyles+=prop+": "+val+"; ";return"";});if(!wrapperExtractedStyles.includes("width")){wrapperExtractedStyles+="width: 100%; ";}
var controlHTML="<div class='range-slider "+
(data.hasOwnProperty('vertical')?" vert-slider ":"")+
"' style='width: 100%; max-width: 100%; box-sizing: border-box;'>"+
"<input id='sl"+id+"' type='range' min='0' max='100' value='"+data.value+"' "+
"style='"+innerStyle+"' class='range-slider__range'><span class='range-slider__value'>"+
data.value+"</span></div>";var wrapperStyle="display: inline-flex; flex-direction: column; align-items: flex-start; vertical-align: bottom; max-width: 100%; "+wrapperExtractedStyles;return"<div id='slider-wrapper-"+id+"' style='"+wrapperStyle+"'>"+nestedLabel+controlHTML+"</div>";case UI_NUMBER:var customStyle=data.hasOwnProperty('elementStyle')?data.elementStyle:"";var isNested=data.hasOwnProperty('parentControl')&&$("#tab"+data.parentControl).length===0;var safeLabel=data.label?data.label.replace(/<[^>]*>?/gm,'').replace(/'/g,"&#39;").replace(/"/g,"&quot;"):"";var onClickScript="this.style.whiteSpace = this.style.whiteSpace === 'nowrap' ? 'normal' : 'nowrap';";var nestedLabel=isNested?"<div id='input-label-"+id+"' title='"+safeLabel+"' onclick=\""+onClickScript+"\" style='font-size:14px; text-align: left; margin-bottom:2px; white-space: nowrap; overflow: hidden; text-overflow: ellipsis; max-width: 100%; width: 100%; cursor: pointer;'>"+data.label+"</div>":"";var placeholder=" placeholder='"+safeLabel+"' ";var wrapperExtractedStyles="";var innerStyle=customStyle.replace(/(?:^|\s)(width|min-width|max-width|margin(?:-[a-z]+)?|float)\s*:\s*([^;]+);?/gi,function(match,prop,val){wrapperExtractedStyles+=prop+": "+val+"; ";return"";});if(!wrapperExtractedStyles.includes("width")){wrapperExtractedStyles+="width: 100%; ";}
var controlHTML="<input id='num"+id+"' type='number' "+placeholder+
"style='width: 100%; max-width: 100%; box-sizing: border-box; color:black; "+innerStyle+"' "+
"value='"+data.value+"' oninput='numberchange("+id+")' />";var wrapperStyle="display: inline-flex; flex-direction: column; align-items: flex-start; vertical-align: bottom; max-width: 100%; "+wrapperExtractedStyles;return"<div id='number-wrapper-"+id+"' style='"+wrapperStyle+"'>"+nestedLabel+controlHTML+"</div>";case UI_TEXT_INPUT:var customStyle=data.hasOwnProperty('elementStyle')?data.elementStyle:"";var isNested=data.hasOwnProperty('parentControl')&&$("#tab"+data.parentControl).length===0;var safeLabel=data.label?data.label.replace(/<[^>]*>?/gm,'').replace(/'/g,"&#39;").replace(/"/g,"&quot;"):"";var onClickScript="this.style.whiteSpace = this.style.whiteSpace === 'nowrap' ? 'normal' : 'nowrap';";var nestedLabel=isNested?"<div id='input-label-"+id+"' title='"+safeLabel+"' onclick=\""+onClickScript+"\" style='font-size:14px; text-align: left; margin-bottom:2px; white-space: nowrap; overflow: hidden; text-overflow: ellipsis; max-width: 100%; width: 100%; cursor: pointer;'>"+data.label+"</div>":"";var placeholder=" placeholder='"+safeLabel+"' ";var readonly=(data.hasOwnProperty('readonly')&&data.readonly)?" readonly ":"";var spellcheck=data.hasOwnProperty('spellcheck')&&!data.spellcheck?" spellcheck='false' ":"";var wrapperExtractedStyles="";var innerStyle=customStyle.replace(/(?:^|\s)(width|min-width|max-width|margin(?:-[a-z]+)?|float)\s*:\s*([^;]+);?/gi,function(match,prop,val){wrapperExtractedStyles+=prop+": "+val+"; ";return"";});if(!wrapperExtractedStyles.includes("width")&&(!data.hasOwnProperty('textarea')||!data.textarea)){wrapperExtractedStyles+="width: 100%; ";}
var controlHTML="";if(data.hasOwnProperty('textarea')&&data.textarea){var rows=data.hasOwnProperty('rows')?" rows='"+data.rows+"' ":" rows='4' ";var cols=data.hasOwnProperty('cols')?" cols='"+data.cols+"' ":"";controlHTML="<textarea id='text"+id+"' "+rows+cols+placeholder+readonly+spellcheck+
"style='width: 100%; max-width: 100%; box-sizing: border-box; color:black; "+innerStyle+"' oninput='textchange("+id+")'>"+
data.value+"</textarea>";}else{var inputType=data.hasOwnProperty('inputType')?" type='"+data.inputType+"' ":" type='text' ";controlHTML="<input id='text"+id+"' "+inputType+placeholder+readonly+spellcheck+
"style='width: 100%; max-width: 100%; box-sizing: border-box; color:black; "+innerStyle+"' value='"+data.value+"' "+
"oninput='textchange("+id+")' />";}
var wrapperStyle="display: inline-flex; flex-direction: column; align-items: flex-start; vertical-align: bottom; max-width: 100%; "+wrapperExtractedStyles;return"<div id='text-wrapper-"+id+"' style='"+wrapperStyle+"'>"+nestedLabel+controlHTML+"</div>";case UI_COLOR_PICKR:return"<div class='espui-color-pickr' "+elementStyle+">"+
"<button type='button' id='colorbtn"+id+"' aria-label='Open color picker'></button>"+
"<input type='text' id='text"+id+"' maxlength='7' pattern='#[0-9a-fA-F]{6}' "+
"aria-label='Color in hexadecimal RGB' autocomplete='off' spellcheck='false' "+
"onchange='commitColorPickr("+id+")' /></div>";case UI_SELECT:var customStyle=data.hasOwnProperty('elementStyle')?data.elementStyle:"";var isNested=data.hasOwnProperty('parentControl')&&$("#tab"+data.parentControl).length===0;var safeLabel=data.label?data.label.replace(/<[^>]*>?/gm,'').replace(/'/g,"&#39;").replace(/"/g,"&quot;"):"";var onClickScript="this.style.whiteSpace = this.style.whiteSpace === 'nowrap' ? 'normal' : 'nowrap';";var nestedLabel=isNested?"<div id='input-label-"+id+"' title='"+safeLabel+"' onclick=\""+onClickScript+"\" style='font-size:14px; text-align: left; margin-bottom:2px; white-space: nowrap; overflow: hidden; text-overflow: ellipsis; max-width: 100%; width: 100%; cursor: pointer;'>"+data.label+"</div>":"";var wrapperExtractedStyles="";var innerStyle=customStyle.replace(/(?:^|\s)(width|min-width|max-width|margin(?:-[a-z]+)?|float)\s*:\s*([^;]+);?/gi,function(match,prop,val){wrapperExtractedStyles+=prop+": "+val+"; ";return"";});if(!wrapperExtractedStyles.includes("width")){wrapperExtractedStyles+="width: 100%; ";}
var controlHTML="<select id='select"+id+"' "+
"style='width: 100%; max-width: 100%; box-sizing: border-box; color:black; "+innerStyle+"' "+
"onchange='selectchange("+id+")'></select>";var wrapperStyle="display: inline-flex; flex-direction: column; align-items: flex-start; vertical-align: bottom; max-width: 100%; "+wrapperExtractedStyles;return"<div id='select-wrapper-"+id+"' style='"+wrapperStyle+"'>"+nestedLabel+controlHTML+"</div>";case UI_GRAPH:return"<figure id='graph"+id+"'><figcaption>"+data.label+"</figcaption></figure>";case UI_GAUGE:return"WILL BE A GAUGE <input style='color:black;' id='gauge"+id+
"' type='number' value='"+data.value+"' onchange='numberchange("+id+")' />";case UI_ACCEL:return"ACCEL // Not implemented fully!<div class='accelerometer' id='accel"+id+
"' ><div class='ball"+id+"'></div><pre class='accelerometeroutput"+id+"'></pre>";default:return"";}}
var processEnabled=function(data){switch(data.type){case UI_SWITCHER:case UPDATE_SWITCHER:if(data.enabled){$("#sl"+data.id).removeClass('disabled');$("#s"+data.id).prop("disabled",false);}else{$("#sl"+data.id).addClass('disabled');$("#s"+data.id).prop("disabled",true);}
break;case UI_SLIDER:case UPDATE_SLIDER:$("#sl"+data.id).prop("disabled",!data.enabled);break;case UI_NUMBER:case UPDATE_NUMBER:$("#num"+data.id).prop("disabled",!data.enabled);break;case UI_TEXT_INPUT:case UPDATE_TEXT_INPUT:$("#text"+data.id).prop("disabled",!data.enabled);break;case UI_COLOR_PICKR:case UPDATE_COLOR_PICKR:$("#text"+data.id).prop("disabled",!data.enabled);$("#colorbtn"+data.id).prop("disabled",!data.enabled);var pickrState=colorPickrInstances[data.id];if(pickrState&&pickrState.ready){if(data.enabled){pickrState.picker.enable();}else{pickrState.picker.hide();syncColorPickr(data.id,pickrState.input.dataset.lastColor);pickrState.picker.disable();}}
break;case UI_SELECT:case UPDATE_SELECT:$("#select"+data.id).prop("disabled",!data.enabled);break;case UI_BUTTON:case UPDATE_BUTTON:$("#btn"+data.id).prop("disabled",!data.enabled);break;case UI_PAD:case UI_CPAD:case UPDATE_PAD:case UPDATE_CPAD:case UI_FILEDISPLAY:case UPDATE_FILEDISPLAY:if(data.enabled){$("#id"+data.id+" nav").removeClass('disabled');}else{$("#id"+data.id+" nav").addClass('disabled');}
break;}}
)=====";

const uint8_t JS_CONTROLS_GZIP[8289] PROGMEM = { 31,139,8,0,98,130,240,106,2,255,237,61,107,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0,0 };
